## meta-ampere/meta-jade/conf/machine/mtjade.conf
```bitbake
KMACHINE = "aspeed"
KERNEL_DEVICETREE = "${KMACHINE}-bmc-ampere-${MACHINE}.dtb"
UBOOT_MACHINE = "ast_g5_phy_config"

require conf/machine/include/ast2500.inc
require conf/machine/include/obmc-bsp-common.inc
require conf/distro/include/phosphor-isolation.inc

OBMC_POWER_SUPPLY_INSTANCES = "0 1"

# Reformat SPI flash layout to 64MB
FLASH_SIZE = "65536"
FLASH_UBOOT_OFFSET  = "0"
FLASH_KERNEL_OFFSET = "512"
FLASH_ROFS_OFFSET   = "5632"
FLASH_RWFS_OFFSET   = "49152"

OBMC_MACHINE_FEATURES += "\
        obmc-phosphor-chassis-mgmt \
        obmc-phosphor-flash-mgmt \
        obmc-host-state-mgmt \
        obmc-chassis-state-mgmt \
        obmc-host-ipmi \
        obmc-bmc-state-mgmt \
        obmc-phosphor-fan-mgmt \
        "

VOLATILE_LOG_DIR = "no"

OBMC_IMAGE_EXTRA_INSTALL_append = "\
                                   mtjade-utils \
                                   ampere-usbnet \
                                   driver-binder \
                                   ampere-mac-update \
                                   ampere-flash-utils \
                                   peripheral-manager \
                                   virtual-media \
                                   psu-inventory-update \
                                   ampere-platform-mgmt \
				   logger-systemd \
                                   phosphor-nvme \
                                   ampere-platform-init \
                                   mtjade-gpio-config \
                                  "

PREFERRED_PROVIDER_virtual/obmc-chassis-mgmt = "packagegroup-ampere-apps"
PREFERRED_PROVIDER_virtual/obmc-system-mgmt = "packagegroup-ampere-apps"
PREFERRED_PROVIDER_virtual/obmc-host-ipmi-hw = "phosphor-ipmi-ssif"
PREFERRED_PROVIDER_virtual/obmc-flash-mgmt = "packagegroup-ampere-apps"
PREFERRED_PROVIDER_virtual/phosphor-ipmi-fru-hostfw-config ?= "hostboot-inventory-config-native"
PREFERRED_PROVIDER_virtual/phosphor-led-manager-config-native = "mtjade-led-manager-config-native"
PREFERRED_PROVIDER_virtual/obmc-fan-mgmt = "packagegroup-ampere-apps"
```

## meta-ampere/meta-mitchell/conf/layer.conf
```bitbake
# We have a conf and classes directory, add to BBPATH
BBPATH .= ":${LAYERDIR}"

# We have recipes-* directories, add to BBFILES
BBFILES += "${LAYERDIR}/recipes-*/*/*.bb \
            ${LAYERDIR}/recipes-*/*/*.bbappend"

BBFILE_COLLECTIONS += "mitchell"
BBFILE_PATTERN_mitchell := "^${LAYERDIR}/"
LAYERSERIES_COMPAT_mitchell = "honister kirkstone"
```

## meta-ampere/meta-mitchell/conf/machine/mtmitchell-dcscm.conf
```bitbake
require conf/machine/mtmitchell.conf
KERNEL_DEVICETREE = "${KMACHINE}-bmc-ampere-mtmitchell-dcscm.dtb"
```
